#include "constants.h"
#include <phys253.h>
#include <LiquidCrystal.h>
#include <ServoTINAH.h>         //   ***** from 253 template file

// Define +timeouts here!
#define TSERVO 100
#define TIRDETECT 10
#define TPASSDETECT 300

// TUNED VARIABLES (make them constants in final)
int lbase = 100;
int rbase = 100;
int kp = 40;
int kd = 90;

// INPUT/OUTPUT VARIABLES
int left = 0;
int right = 0;
int leftint = 0;
int rightint = 0;
int l_motor = 0;
int r_motor = 0;

int collision = 0;

// INTERMEDIATE VARIABLES
int p = 0;
int d = 0;
int con = 0;

// ERROR HANDLING
int err = 0;
int recerr = 0;
int lerr = 0;

//TIMING
int q = 0;
int m = 0;

// Clock
int c = 0;

int IRVal = 0;
int IRlevel = 0;
int IRthresh = 300; // !!! to be set to a constant
int turnDecision;
int numPassengers = 0;

int nodeMap[21][21][3] = {{{-1,-1,-1},{-1,-1,-1},{-1,-1,-1},{-1,-1,-1},{-1,-1,-1},{-1,-1,-1},{-1,-1,-1},{-1,-1,-1},{-1,-1,-1},{-1,-1,-1},{11,-1,16},{-1,-1,-1},{-1,-1,-1},{-1,-1,-1},{-1,-1,-1},{-1,-1,-1},{-1,-1,-1},{-1,-1,-1},{-1,-1,-1},{-1,-1,-1},{-1,-1,-1}},
                          {{-1,-1,-1},{-1,-1,-1},{-1,-1,-1},{-1,-1,-1},{-1,-1,-1},{-1,-1,-1},{-1,-1,-1},{-1,11,6},{-1,-1,-1},{-1,-1,-1},{-1,-1,-1},{-1,-1,-1},{-1,-1,-1},{-1,-1,-1},{-1,-1,-1},{-1,-1,-1},{-1,-1,-1},{-1,-1,-1},{-1,-1,-1},{-1,-1,-1},{-1,-1,-1}},
                          {{-1,-1,-1},{-1,-1,-1},{-1,-1,-1},{-1,-1,-1},{-1,-1,-1},{13,12,-1},{-1,-1,-1},{-1,-1,-1},{-1,-1,-1},{-1,-1,-1},{-1,-1,-1},{-1,-1,-1},{-1,-1,-1},{-1,-1,-1},{-1,-1,-1},{-1,-1,-1},{-1,-1,-1},{-1,-1,-1},{-1,-1,-1},{-1,-1,-1},{-1,-1,-1}},
                          {{-1,-1,-1},{-1,-1,-1},{-1,-1,-1},{-1,-1,-1},{-1,-1,-1},{-1,-1,-1},{-1,-1,-1},{-1,-1,-1},{9,-1,14},{-1,-1,-1},{-1,-1,-1},{-1,-1,-1},{-1,-1,-1},{-1,-1,-1},{-1,-1,-1},{-1,-1,-1},{-1,-1,-1},{-1,-1,-1},{-1,-1,-1},{-1,-1,-1},{-1,-1,-1}},
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                          {{-1,-1,-1},{-1,-1,-1},{-1,-1,-1},{-1,-1,-1},{-1,-1,-1},{-1,-1,-1},{-1,-1,-1},{-1,-1,-1},{-1,-1,-1},{-1,-1,-1},{-1,-1,-1},{-1,-1,-1},{-1,-1,-1},{-1,-1,-1},{-1,-1,-1},{14,-1,4},{-1,-1,-1},{-1,-1,-1},{-1,-1,-1},{-1,14,18},{-1,-1,-1}}
                          };

int lastNode = 0;
int nextNode = 10;

void setup() {
  // put your setup code here, to run once:
  #include <phys253setup.txt>
  int initClock;
  Serial.begin(9600); 
  while(!(stopbutton() && startbutton())){
//    IRTest();
    if (initClock == 75) {
      if (startbutton()) {
        IRTest();
      } else {
        initializeRobot2();
      }
      initClock = 0;
    }
    initClock++;
  }
}

void loop() {
  while ( ! stopbutton() ) {
    // digitalRead true if on tape, false otherwise
    left = !digitalRead(LTAPE);
    right = !digitalRead(RTAPE);
    leftint = !digitalRead(LINTTAPE);
    rightint = !digitalRead(RINTTAPE);

    int frontCollision = digitalRead(FBUMP);// || digitalRead(RBUMP) || digitalRead(LBUMP); //|| digitalRead(FRBUMP) || digitalRead(FLBUMP);
    
    tapeFollow();

    if (!(c % 200)) {
      if ( startbutton() ) {
//        //        lbase = knob(6)-300;
//        //        rbase = knob(7)-300;
//        LCD.clear();
//        LCD.setCursor(0, 0);
//        labelPrint("LM", l_motor, "RM", r_motor, "P", KP);
//        LCD.setCursor(0, 1);
//        labelPrint("D", KD, "L", LBASE, "R", RBASE);
        LCD.clear();
        LCD.setCursor(0,0);
        irPrint("L", analogRead(IRFRONTLEFT),"R", analogRead(IRFRONTRIGHT),"S", analogRead(IRFRONT));
        LCD.setCursor(0,1);
        irPrint("L", analogRead(IRLEFT),"R", analogRead(IRRIGHT),"",0);  
      } else {
        LCD.clear();
        LCD.setCursor(0, 0);
        labelPrint("LT", left, "RT", right, "LI", leftint);
        LCD.setCursor(0, 1);
        labelPrint("RI", rightint, "LN", lastNode, "NN", nextNode);
      }
    }    

//    detectPassenger();
    
    if (numPassengers == 1) {
      turnDecision = nextDestDropoff(lastNode, nextNode);
    } else {
      turnDecision = nextDestIntersect(lastNode, nextNode);
    }

    if (leftint || rightint) {
      handleIntersect2();
    }

    if (frontCollision) {
      handleCollision();
    }
    // Serial.print("tinahmain = main loop end\n");
    c++;
  }

  motor.stop_all();
  servoMenu();
//  motorMenu(kp, kd);
}
